## firmware/main/Kconfig.projbuild
```kconfig
menu "Slate Configuration"

config SLATE_DEFAULT_SERVER_URL
    string "Default server URL (shown in captive portal)"
    default ""
    help
        Pre-fill value for the "服务端 URL" field in captive portal.
        Leave empty for production builds (placeholder text in the
        portal HTML guides users). For local dev override via menuconfig
        or sdkconfig.defaults (e.g. http://192.168.x.x:9494).

config SLATE_AP_SSID_PREFIX
    string "SoftAP SSID prefix (suffix is last 2 bytes of MAC)"
    default "Slate"
    help
        AP SSID will be {prefix}-{XX}{YY} where XX:YY is last 2 bytes of MAC.

config SLATE_DEFAULT_TIMEZONE
    string "Default POSIX timezone string for SNTP"
    default "CST-8"
    help
        Used by setenv("TZ", ...) after SNTP sync. CST-8 = China Standard Time.

config SLATE_IDLE_DEEP_SLEEP_MIN
    int "Idle minutes before entering deep sleep"
    default 3
    range 1 60
    help
        没按键 + 不在充电时,N 分钟后进 deep sleep。BOOT/DOWN 键唤醒(GPIO 39 UP
        键不是 RTC IO 不能 ext1 唤醒)。captive portal 期间禁用。动态帧按
        next_wake_sec 配置 RTC timer；静态帧不配置定时唤醒。
        默认 3 分钟，给正常查看/操作留足时间，同时避免长时间空耗电。

endmenu
```
